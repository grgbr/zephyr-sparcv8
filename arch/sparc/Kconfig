## arch/sparc/Kconfig
```kconfig
# Kconfig - SPARC architecture configuration options

#
# Copyright (c) 2017 Parrot S.A.
#
# SPDX-License-Identifier: Apache-2.0
#

choice
	prompt "SPARC SoC Selection"
	depends on SPARC

	source "arch/sparc/soc/*/Kconfig.soc"
endchoice

menu "SPARC Options"
	depends on SPARC

config ARCH
	default "sparc"

config ARCH_DEFCONFIG
	string
	default "arch/sparc/defconfig"

source "arch/sparc/core/Kconfig"

menu "Board Configuration"

source "arch/sparc/soc/*/Kconfig"

endmenu
endmenu
```

## arch/sparc/core/Kconfig
```kconfig
# Kconfig - SPARC core configuration options

#
# Copyright (c) 2017 Parrot S.A.
#
# SPDX-License-Identifier: Apache-2.0
#

config CPU_LEON
	bool
	# Omit prompt to signify "hidden" option
	default n
	help
	This option signifies the use of a CPU of the Leon family.

if CPU_LEON

source "arch/sparc/core/leon/Kconfig"

endif
```

## arch/sparc/core/leon/Kconfig
```kconfig
# Kconfig - SPARC Leon cores configuration options

#
# Copyright (c) 2017 Parrot S.A.
#
# SPDX-License-Identifier: Apache-2.0
#

config CPU_LEON3
        bool
        # Omit prompt to signify "hidden" option
        help
        This option signifies the use of a Leon3 CPU

config CPU_LEON2
        bool
        # Omit prompt to signify "hidden" option
        help
        This option signifies the use of a Leon2 CPU

config	NUM_IRQS
	int
	default 15
	help
	  Number of available interrupts.

config GEN_ISR_TABLES
        default y

config GEN_IRQ_VECTOR_TABLE
        default n

config GEN_SW_ISR_TABLE
        default y

config LEON_PIRQ
        default y

config ATOMIC_OPERATIONS_C
	# implement me !!
	default y
```

## arch/sparc/soc/parrot-o3/Kconfig
```kconfig
# Kconfig - Parrot Octopus 3 family options

#
# Copyright (c) 2017 Parrot S.A.
#
# SPDX-License-Identifier: Apache-2.0
#

config SOC_FAMILY_PARROT_O3
	bool
	# omit prompt to signify a "hidden" option
	default n

if SOC_FAMILY_PARROT_O3

config SOC_FAMILY
	string
	default "parrot-o3"
	depends on SOC_FAMILY_PARROT_O3

endif

source "arch/sparc/soc/parrot-o3/*/Kconfig.soc"
```

## arch/sparc/soc/parrot-o3/Kconfig.soc
```kconfig
# Kconfig - Parrot Octopus 3 series selection

#
# Copyright (c) 2017 Parrot S.A.
#
# SPDX-License-Identifier: Apache-2.0
#

source "arch/sparc/soc/parrot-o3/*/Kconfig.series"
```

## arch/sparc/soc/parrot-o3/bleon/Kconfig.series
```kconfig
# Kconfig - Parrot Octopus3 Big Leon options

#
# Copyright (c) 2017 Parrot S.A.
#
# SPDX-License-Identifier: Apache-2.0
#

config SOC_SERIES_PARROT_O3_BLEON
	bool "Parrot Octopus3 Big Leon SOC implementation"
	depends on SPARC
	select CPU_LEON
	select CPU_LEON2
	select SOC_FAMILY_PARROT_O3
	help
	Enable support for Parrot Octopus3 Big Leon SOC implementation

if SOC_SERIES_PARROT_O3_BLEON

config SOC_SERIES
	string
	default "bleon"

endif
```

## arch/sparc/soc/parrot-o3/bleon/Kconfig.soc
```kconfig
# Kconfig - Parrot Octopus3 Big Leon selection

#
# Copyright (c) 2017 Parrot S.A.
#
# SPDX-License-Identifier: Apache-2.0
#

choice
prompt "Parrot Octopus3 Big Leon SOC implementation"
depends on SOC_SERIES_PARROT_O3_BLEON

config SOC_PARROT_O3_BLEON_QEMU
	bool "Parrot Octopus3 Big Leon QEMU SOC implementation"

endchoice
```

## boards/sparc/qemu_parrot_o3_bleon/Kconfig.board
```kconfig
# Kconfig - Parrot Octopus 3 Big Leon emulation board selection

#
# Copyright (c) 2017 Parrot S.A.
#
# SPDX-License-Identifier: Apache-2.0
#

config BOARD_QEMU_PARROT_O3_BLEON
        bool "Parrot Octopus3 Big Leon Emulation (Qemu)"
        depends on SOC_PARROT_O3_BLEON_QEMU
```

## boards/sparc/qemu_parrot_o3_bleon/Kconfig.defconfig
```kconfig
if BOARD_QEMU_PARROT_O3_BLEON

config BOARD
	default "qemu_parrot_o3_bleon"

endif
```

## boards/sparc/qemu_parrot_o3_bleon/qemu_parrot_o3_bleon_defconfig
```kconfig
CONFIG_SPARC=y
CONFIG_SOC_SERIES_PARROT_O3_BLEON=y
CONFIG_SOC_PARROT_O3_BLEON_QEMU=y
CONFIG_BOARD_QEMU_PARROT_O3_BLEON=y
CONFIG_CONSOLE=y
CONFIG_PRINTK=y
CONFIG_SERIAL=y
CONFIG_UART_CONSOLE=y
CONFIG_UART_CONSOLE_ON_DEV_NAME="uart0"
CONFIG_BOOT_BANNER=y
CONFIG_LEON_TIMER=y
```

## drivers/serial/Kconfig.leon
```kconfig
menuconfig UART_LEON
	bool "Leon UART driver"
	depends on CPU_LEON
	default n
	select SERIAL_HAS_DRIVER
	help
	Enable the Leon SoCs UART driver.
```
